// Definitions for L3GD20 gyro
/dts-v1/;

/ {
	compatible = "brcm,bcm2708";

	fragment@0 {
		target = <&i2c_arm>;

		__overlay__ {
			#address-cells = <0x1>;
			#size-cells = <0x0>;
			status = "okay";

			l3gd20-gyro@6b {
				compatible = "st,l3gd20-gyro";
				reg = <0x6b>;
				status = "okay";
			};
		};
	};
};
